## esp32cam-gc2145/main/Kconfig.projbuild
```kconfig
menu "ESP32-CAM Configuration"

    config WIFI_SSID
        string "WiFi SSID"
        default "myssid"

    config WIFI_PASSWORD
        string "WiFi Password"
        default "mypassword"

    config WIFI_MAX_RETRY
        int "Max WiFi retry count"
        default 5

endmenu
```

## esp32cam-gc2145/sdkconfig.defaults
```kconfig
# PSRAM — ESP32-CAM has 4MB PSRAM, required for camera frame buffers
CONFIG_SPIRAM=y
CONFIG_SPIRAM_MODE_QUAD=y
CONFIG_SPIRAM_SPEED_40M=y
CONFIG_SPIRAM_USE_CAPS_ALLOC=y
CONFIG_SPIRAM_IGNORE_NOTFOUND=y

# Larger flash partition for single-app
CONFIG_PARTITION_TABLE_SINGLE_APP_LARGE=y

# Stack size for app_main
CONFIG_ESP_MAIN_TASK_STACK_SIZE=8192
```
